#include <Wire.h>
#include <Bounce2.h>
#include <ESP8266WiFi.h>
#include <SFE_MicroOLED.h>

#define PIN_RESET 255
#define DC_JUMPER 0
#define PIN_A D5
#define PIN_B D6
#define PIN_C D7
#define PIN_SPEAKER D8

MicroOLED oled( PIN_RESET, DC_JUMPER );

String mac = WiFi.macAddress();
Bounce bounce_a = Bounce();
Bounce bounce_b = Bounce();
Bounce bounce_c = Bounce();

uint8_t bmpuu [] = {
  0x00, 0x00, 0x00, 0x00, 0x00, 0x00, 0x00, 0x00, 0x00, 0x00, 0x00, 0x00, 0x00, 0x00, 0x00, 0x00,
  0x00, 0x00, 0x00, 0x00, 0x00, 0x00, 0x00, 0x00, 0x00, 0x00, 0x00, 0x00, 0x00, 0x80, 0x80, 0x80,
  0x80, 0x80, 0x80, 0x80, 0x80, 0x00, 0x00, 0x00, 0x00, 0x00, 0x00, 0x00, 0x00, 0x00, 0x00, 0x00,
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  0x00, 0x00, 0x00, 0x00, 0x00, 0x00, 0x00, 0x00, 0x00, 0x00, 0x00, 0x00, 0x00, 0x00, 0x00, 0x00
};

class Wapuu {
  private:

    /**
     * What life stage is the Wapuu at?
     *  0 : Eggpuu
     *  1 : Newpuu
     *  2 : Teenpuu
     *  3 : Wapuu
     *  4 : Oldpuu
     *  5 : Deadpuu
     */
    int stage;

    /**
     * How hungry is Wapuu?
     *  Range: 0 (full) - 1023 (starving)
     */
    int hunger;

    /**
     * Current health level.
     *  Range: 0 (dead) - 1023 (max health)
     */
    int health;

    /**
     * Are there poops?
     */
    int poops;

  public:

    /**
     * Initialize a new Wapuu.
     */
    Wapuu();

    /**
     * Increments the `stage` private member variable, unless it's at max already.
     */
    int evolve();

    /**
     * Make the donuts. Increase hunger, age, generate poops, check bounds, etc.
     * 
     * Should trigger off a SimpleTimer.
     */
    void tick();

    /**
     * Print a report of the current state to Serial.
     */
    void report();
};

Wapuu::Wapuu() {
  this->stage = 0;
  this->hunger = 512;
  this->health = 1023;
  this->poops = 0;
}

int Wapuu::evolve() {
  if ( this->stage < 5 ) {
    this->stage++;
  }
  return this->stage;
}

void Wapuu::tick() {
  int ouchies = 0;

  this->hunger++;
  if ( this->hunger > 1023 ) {
    this->hunger = 1023;
    ouchies++;
  }

  // Only lose health if there's untidied poops.
  ouchies += this->poops;
  
  // Make a poop every 200 ticks?  May need tweaking.
  if ( 0 == this->hunger % 200 ) {
    this->poops++;
  }

  // Apply all the health dings, or if all is shipshape, heal a point.
  if ( ouchies > 0 ) {
    this->health -= ouchies;
  } else {
    this->health++;
  }

  // Bound checking.
  if ( this->health > 1023 ) {
    this->health = 1023;
  } else if ( this->health <= 0 ) {
    this->health = 0;
    this->stage = 5;
  }
}

void Wapuu::report() {
  Serial.printf(
      "Stage: %d | Hunger: %d | Health: %d | Poops: %d",
      this->stage,
      this->hunger,
      this->health,
      this->poops
    );
}

void setup() {
  Serial.begin( 74880 );
  Serial.println();
  Serial.println();
  Serial.println( "Mac: " + mac );
  Serial.println();

  oled.begin();
  oled.clear( ALL );
  oled.display();   
  delay( 1000 );
  oled.clear( PAGE );
  oled.drawBitmap( bmpuu );
  oled.display();

  pinMode( PIN_A, INPUT_PULLUP );
  bounce_a.attach( PIN_A );
  bounce_a.interval( 5 );

  pinMode( PIN_B, INPUT_PULLUP );
  bounce_b.attach( PIN_B );
  bounce_b.interval( 5 );

  pinMode( PIN_C, INPUT_PULLUP );
  bounce_c.attach( PIN_C );
  bounce_c.interval( 5 );
}

void loop() {
  bounce_a.update();
  bounce_b.update();
  bounce_c.update();

  if ( bounce_a.fell() ) {
    Serial.println( "Button A Pressed!" );
  }
  if ( bounce_b.fell() ) {
    Serial.println( "Button B Pressed!" );
  }
  if ( bounce_c.fell() ) {
    Serial.println( "Button C Pressed!" );
  }
}
